## untangle-hardware-caswell-driver-gpio-nuvoton/files/usr/src/gpio-nuvoton-1.9.3/Kconfig
```kconfig
config GPIO_NUVOTON
	tristate "GPIO Nuvoton Super I/O"
	default m
	---help---
	  GPIO Nuvoton Super I/O for LEDS, factory reset
```
